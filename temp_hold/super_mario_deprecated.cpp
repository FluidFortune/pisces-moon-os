// Pisces Moon OS
// Copyright (C) 2026 Eric Becker / Fluid Fortune
// SPDX-License-Identifier: AGPL-3.0-or-later
//
// fluidfortune.com
//
// ═════════════════════════════════════════════════════════════
//  DEPRECATED — PRESERVED FOR REFERENCE ONLY
// ═════════════════════════════════════════════════════════════
//
//  This file used to live at src/mario_bros.cpp as a side-scrolling
//  platformer in the spirit of Super Mario Bros. (the protagonist
//  was Captain Pisces, the jumping astronaut). In v1.2.1 it was
//  retired and replaced by a from-scratch implementation of the
//  ORIGINAL 1983 Mario Bros. arcade game (fixed single screen,
//  punch-from-below mechanic, POW block, Shellcreepers / Side
//  steppers / Fighter Flies, ice phase, etc.).
//
//  The side-scroller is preserved here because the engine work
//  (tile-snapped AABB collision, fixed-point physics, variable
//  jump arc) is reusable and may inform future platformer work.
//  But the gameplay as shipped had outstanding bugs that made it
//  unsuitable to feature in production, so it is parked here
//  rather than left active in the build.
//
//  ── Why moved to temp_hold and not deleted ──
//
//  PlatformIO's source discovery scans src/ only. Files under
//  temp_hold/ are skipped automatically — no build_src_filter
//  exclusion needed. This keeps the original implementation on
//  disk for grep / git blame / future port work without any risk
//  of accidentally double-defining run_mario_bros() against the
//  new arcade game.
//
//  ── Why also wrapped in #if 0 ──
//
//  Belt-and-suspenders. If a future developer copies this file
//  back into src/ without reading the banner above, the #if 0
//  guard ensures the compiler still sees an empty translation
//  unit. They have to consciously remove the guard to revive the
//  code, at which point they're aware they're doing so.
//
//  ── Recovering the active version ──
//
//  Remove the #if 0 / #endif pair below, move this file back to
//  src/, rename the entry-point symbol (run_mario_bros has been
//  reclaimed by the arcade game). git log src/mario_bros.cpp
//  also recovers any intermediate revisions.
// ═════════════════════════════════════════════════════════════

#if 0

// Pisces Moon OS
// Copyright (C) 2026 Eric Becker / Fluid Fortune
// SPDX-License-Identifier: AGPL-3.0-or-later
//
// fluidfortune.com
//
// ─────────────────────────────────────────────
//  mario_bros.cpp — Pisces Moon original platformer
//
//  This is NOT a port of Nintendo's Super Mario Bros. The
//  source code is entirely original, the level designs are
//  hand-crafted for Pisces Moon, the protagonist is "Captain
//  Pisces" (the jumping astronaut), and the visual style is
//  our own. The genre is the genre — 2D scrolling platformer
//  with running, jumping, stomping enemies, and coin pickups.
//
//  ENGINE
//
//  Tile world: 16-pixel logical tiles, levels up to 192 tiles
//  wide x 13 tiles tall. Player position kept as fixed-point
//  tile coordinates (1/256ths of a tile) so physics is stable
//  on every device regardless of frame rate.
//
//  Physics: fixed gravity, variable-height jump (hold = higher
//  apex), terminal fall velocity, horizontal acceleration with
//  friction. Tile-snapped AABB collision: at each step, X and Y
//  are resolved separately so corners don't catch.
//
//  Camera: scrolls right when player crosses the 40% threshold
//  of the viewport. Never scrolls back (classic SMB rule).
//
//  Enemies: walker (Goomba-style) and shell-turtle (Koopa-style).
//  Both walk left until they hit a wall, then reverse. Stomping
//  kills walker; stomping turtle puts it into shell state, which
//  the player can then kick. Touching either kills the player
//  if they're not stomping from above (descending vy > 0).
//
//  Hazards: pits (gaps in the floor with no tiles below the
//  death line) and spikes. Both kill instantly.
//
//  Power-ups: coin (score +200), mushroom (one extra hit before
//  death), star (10s of invincibility — flashes player sprite,
//  enemies die on touch).
//
//  Goal: a flagpole (`F` tile) at the end of every level. Touch
//  it to win and advance to the next level. Furthest level
//  reached is persisted to NoSQL so progress survives reboots.
//
//  DEVICES
//
//  All five: T-Deck Plus, T-LoRa Pager, Cardputer ADV, C28P,
//  Maxine. Per-device TILE/viewport scaling. Touch kiosks reuse
//  the existing virtual D-pad chrome (c28p_dpad / maxine_dpad).
//  Keyboard devices use pm_read_nes_input() — A = jump, left/
//  right = move, B = run (faster horizontal speed).
//
//  LEVEL DATA
//
//  30 levels embedded as constexpr char arrays in this file.
//  Each level is a fixed-height grid of single ASCII characters,
//  variable width. The first row is the top of the world (sky),
//  the last row is the floor. The TILE_LOOKUP table maps chars
//  to tile-type behavior.
// ─────────────────────────────────────────────

#include <Arduino.h>
#ifdef DEVICE_TLORAPAGER
#include "pm_disp_tlorapager.h"
#else
#include <Arduino_GFX_Library.h>
#endif
#include "game_input.h"
#include "game_audio.h"
#include "theme.h"
#include "mario_bros.h"
#include "nosql_store.h"

#ifdef DEVICE_C28P
#include "c28p_dpad.h"
#endif
#ifdef DEVICE_MAXINE
#include "maxine_dpad.h"
#endif

#ifdef DEVICE_TLORAPAGER
extern PMDispTLoRaPager *gfx;
#else
extern Arduino_GFX *gfx;
#endif

// ─────────────────────────────────────────────
//  PER-DEVICE GEOMETRY
//
//  TILE = pixel size of one logical tile on this device.
//  VIEW_W / VIEW_H = the rectangle of pixels the game draws
//  into. For touch kiosks the bottom strip belongs to the
//  virtual D-pad chrome and must not be touched here.
//  HUD_H = height of the top status bar (lives/coins/world/time).
//
//  Levels are LEVEL_ROWS tiles tall regardless of device. The
//  device's TILE size determines how many tiles fit vertically;
//  on Cardputer and Pager the world is rendered with the top
//  tiles trimmed to fit, so level designs keep important
//  geometry in the bottom half.
// ─────────────────────────────────────────────

#ifdef DEVICE_CARDPUTER_ADV
static constexpr int VIEW_W   = 240;
static constexpr int VIEW_H   = 135;
static constexpr int TILE     = 10;
static constexpr int HUD_H    = 9;
#elif defined(DEVICE_TLORAPAGER)
static constexpr int VIEW_W   = 480;
static constexpr int VIEW_H   = 222;
static constexpr int TILE     = 14;
static constexpr int HUD_H    = 14;
#elif defined(DEVICE_C28P)
// C28P portrait: game lives in the top 200px above the virtual
// D-pad. 240/15 = 16 tiles wide, (200-12)/14 = ~13 tiles tall.
static constexpr int VIEW_W   = 240;
static constexpr int VIEW_H   = 200;
static constexpr int TILE     = 14;
static constexpr int HUD_H    = 12;
#elif defined(DEVICE_MAXINE)
// Maxine portrait: top 520px game area above the D-pad.
// 480/15 = 32 tiles wide visible. 14 tiles tall fits the level.
static constexpr int VIEW_W   = 480;
static constexpr int VIEW_H   = 520;
static constexpr int TILE     = 30;
static constexpr int HUD_H    = 22;
#else
// T-Deck Plus 320x240
static constexpr int VIEW_W   = 320;
static constexpr int VIEW_H   = 240;
static constexpr int TILE     = 16;
static constexpr int HUD_H    = 14;
#endif

static constexpr int LEVEL_ROWS = 13;
static constexpr int PLAY_H     = VIEW_H - HUD_H;
static constexpr int VIS_ROWS   = (PLAY_H / TILE);   // tiles visible vertically
static constexpr int VIS_COLS   = (VIEW_W / TILE);   // tiles visible horizontally

// ─────────────────────────────────────────────
//  VIEW PLACEMENT
//
//  T-Deck and Pager render the game centered in their display.
//  Touch kiosks (C28P, Maxine) MUST anchor at y=0 so the bottom
//  rows of the display stay reserved for the D-pad chrome.
// ─────────────────────────────────────────────
static int vx() {
    int w = gfx->width();
    return (w > VIEW_W) ? (w - VIEW_W) / 2 : 0;
}
static int vy() {
#if defined(DEVICE_C28P) || defined(DEVICE_MAXINE)
    return 0;
#else
    int h = gfx->height();
    return (h > VIEW_H) ? (h - VIEW_H) / 2 : 0;
#endif
}

// ─────────────────────────────────────────────
//  TILE TYPES + LOOKUP
//
//  TF_ flags describe behavior. SOLID blocks collide on all
//  sides. PLATFORM lets the player jump up through from below
//  but stand on top. KILL kills the player instantly. COIN
//  is a pickup. BUMP is a question/brick block that pops when
//  hit from underneath. GOAL is the level-end flagpole. PIPE
//  is solid + visually distinct.
// ─────────────────────────────────────────────
enum TileFlag {
    TF_EMPTY    = 0,
    TF_SOLID    = 1 << 0,
    TF_PLATFORM = 1 << 1,
    TF_KILL     = 1 << 2,
    TF_COIN     = 1 << 3,
    TF_BUMP     = 1 << 4,
    TF_GOAL     = 1 << 5,
    TF_PIPE     = 1 << 6,
};

struct TileDef {
    char     ch;
    uint8_t  flags;
    uint16_t color;
    uint16_t accent;
};

static const TileDef TILE_LOOKUP[] = {
    { '.', TF_EMPTY,                0x0000, 0x0000 },  // sky
    { ' ', TF_EMPTY,                0x0000, 0x0000 },  // sky
    { '#', TF_SOLID,                0x9261, 0x6105 },  // ground/dirt
    { 'B', TF_SOLID,                0xA284, 0x6105 },  // brick (solid bedrock)
    { 'b', TF_SOLID | TF_BUMP,      0xC388, 0x8208 },  // brick (poppable)
    { '?', TF_SOLID | TF_BUMP,      0xFD20, 0xC300 },  // question block
    { '=', TF_PLATFORM,             0xC388, 0x8208 },  // one-way platform
    { '|', TF_SOLID | TF_PIPE,      0x0660, 0x0420 },  // pipe body
    { '_', TF_SOLID | TF_PIPE,      0x07E0, 0x0420 },  // pipe top
    { '^', TF_KILL,                 0xC618, 0x8410 },  // spike
    { '~', TF_KILL,                 0xF800, 0xC000 },  // lava
    { 'F', TF_GOAL,                 0x07E0, 0xFFFF },  // flagpole
    { 'X', TF_SOLID,                0x39E7, 0x18C3 },  // dark stone
    { 'C', TF_SOLID,                0x39E7, 0x18C3 },  // castle stone
    { 0,   0,                       0,      0      },
};

static const TileDef* lookup_tile(char c) {
    for (int i = 0; TILE_LOOKUP[i].ch != 0; i++) {
        if (TILE_LOOKUP[i].ch == c) return &TILE_LOOKUP[i];
    }
    return &TILE_LOOKUP[0];  // default: empty/sky
}

// Convenience predicate: is this character a "render-as-tile"?
// (Anything in TILE_LOOKUP. Entities and pickups go through
// separate sprite lists rather than rendering tiles directly.)
static bool is_passable_for_lookup(char c) {
    const TileDef* t = lookup_tile(c);
    return (t->flags & (TF_SOLID | TF_PLATFORM)) == 0;
}

// ─────────────────────────────────────────────
//  LEVEL DATA — 30 hand-crafted levels.
//
//  Each level is 13 rows tall. Row 0 = top of world (sky).
//  Row 12 = ground line (always solid unless deliberately a pit).
//  Width is variable per level (80..192 columns).
//
//  Char legend (matches TILE_LOOKUP plus a few entity spawn marks):
//      .  sky
//      #  ground
//      B  hard brick (boundary)
//      b  poppable brick
//      ?  question block (coin reward)
//      =  one-way platform
//      |  pipe body
//      _  pipe top
//      ^  spike
//      ~  lava
//      F  flagpole (level goal)
//      X  dark stone
//      *  coin pickup (entity, not a tile)
//      g  goomba walker spawn (entity)
//      k  koopa turtle spawn (entity)
//      M  mushroom spawn (entity)
//      S  star spawn (entity)
//      P  player spawn point (entity)
//
//  Entities are extracted at level load time and the spawn cell
//  is overwritten with sky in the tile grid. So an entity char in
//  the source data acts both as spawn marker and "tile underneath
//  is sky". If you want an enemy standing on a brick, place the
//  brick char on the row below.
// ─────────────────────────────────────────────

#define LV(...) { __VA_ARGS__ }

// L1: "First Steps" — gentle introduction, no enemies, two coins,
// a single ? block, mostly flat ground.
static const char* const L1[] = LV(
"................................................................................",
"................................................................................",
"................................................................................",
"................................................................................",
"................................................................................",
"................................................................................",
"...........*....................*..............................................",
"................................................................................",
".............?....................?...............b?b...........................",
"................................................................................",
".........P......................................................................",
"...................................................................F............",
"################################################################################"
);

// L2: "First Hop" — introduces a small gap and a low brick stack.
static const char* const L2[] = LV(
"................................................................................",
"................................................................................",
"................................................................................",
"................................................................................",
"................................................................................",
".......................*.....*.....*...........................................",
"................................................................................",
"................................................................................",
".......?...............................bbb......?..............................",
"................................................................................",
"......P.....................................................................F..",
"....................###...........#####...........#######......................",
"###############......###...........#####...........#######....###################"
);

// L3: "Mind the Pit" — first deadly pit. Sky and a platform to clear it.
static const char* const L3[] = LV(
"................................................................................",
"................................................................................",
"................................................................................",
"................................................................................",
"................................................................................",
"...................*..................*........*...............................",
"................................................................................",
"...........bb?bb.........bb=bb...................................bb?bb..........",
"................................................................................",
"................................................................................",
"......P......................................................................F.",
"................................................................................",
"##########.................##############..............###################......"
);

// L4: "Meet a Goomba" — first enemy. Single walker, easy stomp.
static const char* const L4[] = LV(
"................................................................................",
"................................................................................",
"................................................................................",
"................................................................................",
"................................................................................",
".................*..................*......*.........*.........................",
"................................................................................",
".......?.....................?.....................b?b.........................",
"................................................................................",
"................................................................................",
"....P............g..........................g........................g........F",
"................................................................................",
"################################################################################"
);

// L5: "Stair Climb" — staircase up, then down. No enemies, focus on running jumps.
static const char* const L5[] = LV(
"................................................................................",
"................................................................................",
"................................................................................",
".........................*....................*....*.....*.....*...............",
"......................................##......................................",
"...................................######......................................",
"................................##########......................................",
".............................##############.....................................",
"..........................#################......................................",
".......................####################.....................................",
"....................#######################......................................",
"....P...............########################...............M..................F.",
"################################################################################"
);

// L6: "Spiked Floor" — first spike hazard at floor level.
static const char* const L6[] = LV(
"................................................................................",
"................................................................................",
"................................................................................",
"................................................................................",
"................................................................................",
"................................................................................",
"....................*..............*......................*....................",
"................................................................................",
"..........?....................bb?bb...................?.......................",
"................................................................................",
"....P.....................g.........................g........................F.",
"................................................................................",
"####################^^####################^^##############^^^^^^###############."
);

// L7: "Twin Pipes" — two pipes to leap over. Coins between.
static const char* const L7[] = LV(
"................................................................................",
"................................................................................",
"................................................................................",
"................................................................................",
"................................................................................",
"................................................................................",
"...........*..........*..........*..........*..........*..........*............",
"...................................................................____........",
"........................____.......................................||||.......",
"............____........||||.......................................||||.......",
"............||||........||||...................................____.||||.......",
"....P.......||||..g..g..||||..g..g..g.................?........||||.||||..g..g.F",
"################################################################################"
);

// L8: "Brick Maze" — overhead bricks force the player to drop and weave.
static const char* const L8[] = LV(
"................................................................................",
"................................................................................",
"................................................................................",
"......................bbbbbb..................bbbbbbb..........................",
"......................b....b..................b.....b..........................",
"......................b.?..b..................b..?..b..........................",
"......................b....b..................b.....b..........................",
"...............*......bbb=bb...........*......bbb=bbb..........*...............",
"................................................................................",
"................................................................................",
"....P...........................g..............................g.............F.",
"................................................................................",
"################################################################################"
);

// L9: "Lava Crossing" — gap with lava, stepping platforms.
static const char* const L9[] = LV(
"................................................................................",
"................................................................................",
"................................................................................",
"................................................................................",
"................................................................................",
".........................*.....*.....*.....*.....*.............................",
"................................................................................",
"...................................================.............................",
".......?......................................................?................",
"................==..............................================...............",
"....P.......................................................................F..",
"...........###.......###.................###.......###.................###......",
"########### ~~~~~~~~~ ~~~~~~~~~~~~~~~~~~~ ~~~~~~~~~ ~~~~~~~~~~~~~~~~~ ~~~########"
);

// L10: "Bonus Den" — short level, packed with coins and a star.
static const char* const L10[] = LV(
"................................................................................",
"................................................................................",
"................................................................................",
"...........*..*..*..*..*..*..*..*..*..*..*..*..*..*..*..*..*..*..*..*..*........",
"................................................................................",
"...........bbbbbbbbbbbbbbbbbbbbbbbbbbbbbbbbbbbbbbbbbbbbbbbbbbbbbbbbbbbbbbb.......",
"................................................................................",
"...........*..*..*..*..*..*..*..*..*..*..*..*..*..*..*..*..*..*..*..*..*........",
"................................................................................",
"...........bbbbbbbbbbbbbbbbbbbbbbbbbbbbbbbbbbbbbbbbbbbbbbbbbbbbbbbbbbbbbbb.......",
"....P...........................S...............................................F",
"................................................................................",
"################################################################################"
);

// L11: "Trap Door" — multiple pits in sequence, requires precise jumps.
static const char* const L11[] = LV(
"................................................................................",
"................................................................................",
"................................................................................",
"................................................................................",
"................................................................................",
".................*........*........*........*........*...........*.............",
"................................................................................",
".........?...............b?b......................?...............?.............",
"................................................................................",
"................................................................................",
"....P........................g..............g................................F.",
"................................................................................",
"########......####......######......####......######......####......############"
);

// L12: "Koopa Welcome" — first turtle enemy, with a brick to bounce shell off.
static const char* const L12[] = LV(
"................................................................................",
"................................................................................",
"................................................................................",
"................................................................................",
"................................................................................",
"...........*...........*...........*...........*...........*...................",
"................................................................................",
".......?...........................?...........................b?b.............",
"................................................................................",
"................................................................................",
"....P...............k........g......................k........g.................F",
"................................................................................",
"################################################################################"
);

// L13: "High Wire" — long stretch of platforms above lava.
static const char* const L13[] = LV(
"................................................................................",
"................................................................................",
"................................................................................",
"................................................................................",
"..............*......*......*......*......*......*......*......*...............",
"................................................................................",
"............=====.=====.=====.=====.=====.=====.=====.=====.=====.=====.........",
"................................................................................",
"................................................................................",
"................................................................................",
"....P...........................................................S............F.",
"....######...................................................................###",
"....######~~~~~~~~~~~~~~~~~~~~~~~~~~~~~~~~~~~~~~~~~~~~~~~~~~~~~~~~~~~~~~~~~~~###"
);

// L14: "Brick Maze 2" — denser overhead with more bumpable bricks.
static const char* const L14[] = LV(
"................................................................................",
"................................................................................",
".....b?b........b?b........b?b........b?b........b?b........b?b........b?b.......",
"................................................................................",
"......b..........b..........b..........b..........b..........b..........b........",
"......b..........b..........b..........b..........b..........b..........b........",
".....bbb........bbb........bbb........bbb........bbb........bbb........bbb.......",
"................................................................................",
"..........*..........*..........*..........*..........*..........*..............",
"................................................................................",
"....P............g........k........g........k........g........k................F",
"................................................................................",
"################################################################################"
);

// L15: "Halfway" — milestone level. Long, with everything seen so far.
static const char* const L15[] = LV(
"................................................................................",
"................................................................................",
"................................................................................",
"................................................................................",
"........................*......................*..............................",
".....................==========..............=========..........................",
"................................................................................",
"...........?....................b?b......................b?bb..................",
"................................................................................",
".................____...........________...............____...................",
"....P.......g....||||...k..g.....||||||||..k..g.........||||.....g..k........F..",
"................................................................................",
"##########################^^############^^###############^^###############......"
);

// L16: "Sky High" — most action is on raised platforms.
static const char* const L16[] = LV(
"................................................................................",
"................................................................................",
"................................................................................",
"......................*..............*..............*..........................",
"...........=========...........=========...........=========...................",
".................?....................?....................?...................",
"................................................................................",
"....========......===========......===========......===========.................",
"................................................................................",
".......===.............===.............===.............===......................",
"....P............................................................S............F",
"................................................................................",
"################################################################################"
);

// L17: "Spike Gauntlet" — narrow paths with spikes on both sides of platforms.
static const char* const L17[] = LV(
"................................................................................",
"................................................................................",
"................................................................................",
"................................................................................",
"................................................................................",
".........*.........*.........*.........*.........*.........*.........*..........",
"................................................................................",
"........b?b.......b?b.......b?b.......b?b.......b?b.......b?b.......b?b.........",
"................................................................................",
"................................................................................",
"....P............................g........g........g........g.................F",
"......^^^.......^^^.......^^^.......^^^.......^^^.......^^^.......^^^...........",
"################################################################################"
);

// L18: "Underground" — dark theme using X (stone) tiles, low ceiling.
static const char* const L18[] = LV(
"XXXXXXXXXXXXXXXXXXXXXXXXXXXXXXXXXXXXXXXXXXXXXXXXXXXXXXXXXXXXXXXXXXXXXXXXXXXXXXXX",
"XXXXXXXXXXXXXXXXXXXXXXXXXXXXXXXXXXXXXXXXXXXXXXXXXXXXXXXXXXXXXXXXXXXXXXXXXXXXXXXX",
"XXXXXXXXXXXXXXXXXXXXXXXXXXXXXXXXXXXXXXXXXXXXXXXXXXXXXXXXXXXXXXXXXXXXXXXXXXXXXXXX",
"XX..........................................................................XX.",
"XX..*...*...*...*...*...*...*...*...*...*...*...*...*...*...*...*...*...*...XX.",
"XX..........................................................................XX.",
"XX.......?................b?b....................?...........b?b...........XX..",
"XX..........................................................................XX.",
"XX..........................................................................XX.",
"XX..........................................................................XX.",
"XX..P........g......k...........g........k...........g........k............XX.F",
"XX..........................................................................XX.",
"XXXXXXXXXXXXXXXXXXXXXXXXXXXXXXXXXXXXXXXXXXXXXXXXXXXXXXXXXXXXXXXXXXXXXXXXXXXXXXXX"
);

// L19: "Pipe Forest" — multiple pipes of varying height.
static const char* const L19[] = LV(
"................................................................................",
"................................................................................",
"................................................................................",
"............____.........................____..................................",
"............||||........____..............||||.........____.....................",
"............||||........||||..____........||||.........||||......____...........",
"....____....||||....____.||||.||||...____.||||.____....||||..____.||||..........",
"....||||....||||....||||.||||.||||...||||.||||.||||....||||..||||.||||..........",
"....||||....||||....||||.||||.||||...||||.||||.||||....||||..||||.||||..........",
"................................................................................",
"....P.......g........k........g........k........g........k....................F",
"................................................................................",
"################################################################################"
);

// L20: "Brick & Lava" — climbing over lava pits via brick platforms.
static const char* const L20[] = LV(
"................................................................................",
"................................................................................",
"................................................................................",
"................................................................................",
".............*..................*..................*..........*................",
"............b?b................b?b................b?b........b?b...............",
"................................................................................",
"....======.........======.........======.........======.........======..........",
"................................................................................",
"................................................................................",
"....P.....................................................................S..F.",
"....######...####...####...####...####...####...####...####...####...####...####",
"....######~~~####~~~####~~~####~~~####~~~####~~~####~~~####~~~####~~~####~~~####"
);

// L21: "Goomba March" — many walkers, careful stomping.
static const char* const L21[] = LV(
"................................................................................",
"................................................................................",
"................................................................................",
"................................................................................",
"................................................................................",
"...........*.....*.....*.....*.....*.....*.....*.....*.....*.....*.............",
"................................................................................",
".......?.....?.....?.....?.....?.....?.....?.....?.....?.....?.....?...........",
"................................................................................",
"................................................................................",
"....P...g..g..g..g..g..g..g..g..g..g..g..g..g..g..g..g..g..g..g..g..g..g.....F.",
"................................................................................",
"################################################################################"
);

// L22: "Shell Game" — chains of turtles, shell kicks for combos.
static const char* const L22[] = LV(
"................................................................................",
"................................................................................",
"................................................................................",
"................................................................................",
".............*...............*...............*...............*.................",
"............b?b.............b?b.............b?b.............b?b................",
"................................................................................",
"...........bbbbb...........bbbbb...........bbbbb...........bbbbb...............",
"................................................................................",
"................................................................................",
"....P............k.k.k............k.k.k............k.k.k............k........F.",
"................................................................................",
"################################################################################"
);

// L23: "Sky Bridge" — long horizontal platform far above ground.
static const char* const L23[] = LV(
"................................................................................",
"................................................................................",
"................................................................................",
"...........*.....*.....*.....*.....*.....*.....*.....*.....*.....*.............",
"................................................................................",
"...........================================================================....",
"................................................................................",
".................?...........?...........?...........?...........?...........?.",
"................................................................................",
"................................................................................",
"....P..........................................................................F",
"................................................................................",
"^^^^^###^^^###^^^###^^^###^^^###^^^###^^^###^^^###^^^###^^^###^^^###^^^###^^^###"
);

// L24: "Castle Approach" — denser walls, more bricks, two-tier exploration.
static const char* const L24[] = LV(
"................................................................................",
"................................................................................",
".....CCCC.......CCCC........CCCC.......CCCC........CCCC.......CCCC.............",
".....C..C.......C..C........C..C.......C..C........C..C.......C..C.............",
".....C..C.......C..C........C..C.......C..C........C..C.......C..C.............",
".....C..C.......C..C........C..C.......C..C........C..C.......C..C.............",
"................................................................................",
".......*.............*..........*.............*..........*.............*........",
"................................................................................",
".......?.............?..........?.............?..........?.............?.......",
"....P............g........k.............g........k.............g........k....F.",
"................................................................................",
"################################################################################"
);

// L25: "Hidden Treasure" — rooms with bonus coins via specific routes.
static const char* const L25[] = LV(
"................................................................................",
".......bbb...........bbb...........bbb...........bbb...........bbb..............",
".......b.b...........b.b...........b.b...........b.b...........b.b..............",
".......b*b...........b*b...........b*b...........b*b...........b*b..............",
".......b.b...........b.b...........b.b...........b.b...........b.b..............",
".......bbb...........bbb...........bbb...........bbb...........bbb..............",
"................................................................................",
"...............*..........*..........*..........*..........*...................",
"................................................................................",
"...........?......?......?......?......?......?......?......?......?...........",
"....P............g........k........g........k........g........k........k.....F.",
"................................................................................",
"################################################################################"
);

// L26: "Spike Pit Express" — long stretch with continuous spike floor.
static const char* const L26[] = LV(
"................................................................................",
"................................................................................",
"................................................................................",
"................................................................................",
"................................................................................",
"............*.................*.................*..........................*..",
"................................................................................",
".......?.....................?.....................?...........................",
"................................................................................",
"....========.........========.........========.........========.................",
"....P.........................................................................F.",
"................................................................................",
"#####^^^^^^^^^^^^^^^^^^^^^^^^^^^^^^^^^^^^^^^^^^^^^^^^^^^^^^^^^^^^^^^^^^^^^^^#####"
);

// L27: "Mushroom Kingdom" — heavy power-up density, prep for the gauntlet.
static const char* const L27[] = LV(
"................................................................................",
"................................................................................",
"................................................................................",
"................................................................................",
".........M........M.................M........M.................M.......S......",
"........b?b......b?b...............b?b......b?b...............b?b......b?b.....",
"................................................................................",
"................................................................................",
"...........*.....*..........*.....*..........*.....*..........*.....*..........",
"................................................................................",
"....P............g.g.g..........g.g.g..........g.g.g..........k.k.k...........F",
"................................................................................",
"################################################################################"
);

// L28: "The Gauntlet" — combination of every hazard: pits, lava, spikes, enemies.
static const char* const L28[] = LV(
"................................................................................",
"................................................................................",
"................................................................................",
"................................................................................",
"................................................................................",
".......*........*......*........*......*........*......*........*..............",
"................................................................................",
"....b?b....bbb...bbb...bbb...bbb...bbb...bbb...bbb...bbb...bbb...b?b...........",
"................................................................................",
"................................................................................",
"....P...........g..k............g..k............g..k............g..k.........F.",
"....######....######........######....######........######....######............",
"....######^^^~~~~~^^^########~~~~~~~~^^^######^^^^^^~~~~~~##########~~~~~####### "
);

// L29: "Almost There" — fast course of running jumps, no time to rest.
static const char* const L29[] = LV(
"................................................................................",
"................................................................................",
"................................................................................",
"................................................................................",
".......*........*........*........*........*........*........*........*.......",
"................................................................................",
"......===......===......===......===......===......===......===......===........",
"................................................................................",
"...........b?b........b?b........b?b........b?b........b?b........b?b...........",
"................................................................................",
"....P............g..g........k..k........g..g........k..k........g..g........F.",
"................................................................................",
"#####...####...####...####...####...####...####...####...####...####...#########"
);

// L30: "Final Castle" — the longest, hardest, with star pickup before final flag.
static const char* const L30[] = LV(
"................................................................................",
"CCCCCCCCCCCCCCCCCCCCCCCCCCCCCCCCCCCCCCCCCCCCCCCCCCCCCCCCCCCCCCCCCCCCCCCCCCCCCCCC.",
"C............................................................................C.",
"C......*......*......*......*......*......*......*......*......*......*.....C.",
"C............................................................................C.",
"C....bb?bb..........bb?bb..........bb?bb..........bb?bb..........bb?bb.......C.",
"C............................................................................C.",
"C.....======......======......======......======......======......======....C.",
"C............................................................................C.",
"C............................................................................C.",
"C..P...g....k....g....k....g....k....g....k....g....k....g....k....S.......FC.",
"C............................................................................C.",
"CCCCC^^^^^^^^^^^^^^^^^^^^^^^^^^^^^^^^^^^^^^^^^^^^^^^^^^^^^^^^^^^^^^^^^^^^^^^CCCC"
);

// ─────────────────────────────────────────────
//  LEVEL INDEX
//
//  Each entry: pointer to the row array + level width in tiles.
//  Width is computed from strlen of row 0; all rows MUST be the
//  same width — the level loader trusts row 0's width.
// ─────────────────────────────────────────────
struct LevelDef {
    const char* const* rows;
    const char*        name;
};

static const LevelDef LEVELS[] = {
    { L1,  "1-1: FIRST STEPS"     },
    { L2,  "1-2: FIRST HOP"       },
    { L3,  "1-3: MIND THE PIT"    },
    { L4,  "1-4: MEET A GOOMBA"   },
    { L5,  "1-5: STAIR CLIMB"     },
    { L6,  "2-1: SPIKED FLOOR"    },
    { L7,  "2-2: TWIN PIPES"      },
    { L8,  "2-3: BRICK MAZE"      },
    { L9,  "2-4: LAVA CROSSING"   },
    { L10, "2-5: BONUS DEN"       },
    { L11, "3-1: TRAP DOOR"       },
    { L12, "3-2: KOOPA WELCOME"   },
    { L13, "3-3: HIGH WIRE"       },
    { L14, "3-4: BRICK MAZE 2"    },
    { L15, "3-5: HALFWAY"         },
    { L16, "4-1: SKY HIGH"        },
    { L17, "4-2: SPIKE GAUNTLET"  },
    { L18, "4-3: UNDERGROUND"     },
    { L19, "4-4: PIPE FOREST"     },
    { L20, "4-5: BRICK & LAVA"    },
    { L21, "5-1: GOOMBA MARCH"    },
    { L22, "5-2: SHELL GAME"      },
    { L23, "5-3: SKY BRIDGE"      },
    { L24, "5-4: CASTLE APPROACH" },
    { L25, "5-5: HIDDEN TREASURE" },
    { L26, "6-1: SPIKE EXPRESS"   },
    { L27, "6-2: MUSHROOM KINGDOM"},
    { L28, "6-3: THE GAUNTLET"    },
    { L29, "6-4: ALMOST THERE"    },
    { L30, "6-5: FINAL CASTLE"    },
};
static constexpr int NUM_LEVELS = (int)(sizeof(LEVELS) / sizeof(LevelDef));

// ─────────────────────────────────────────────
//  RUNTIME LEVEL STATE
//
//  At level load time we copy the const data into a mutable
//  grid (so bricks can pop and disappear), extract entity
//  spawn cells into the entity list, and compute the width.
//
//  MAX_LEVEL_W bounds the grid array. The largest level above
//  is 80 chars wide; bump this if you add wider levels.
// ─────────────────────────────────────────────
static constexpr int MAX_LEVEL_W = 192;
static char  grid[LEVEL_ROWS][MAX_LEVEL_W + 1];
static int   level_w = 0;

static char tile_at(int tx, int ty) {
    if (tx < 0 || tx >= level_w || ty < 0 || ty >= LEVEL_ROWS) {
        // Outside the level grid: bottom is "kill plane" (player
        // falls into the void), top/sides are sky/solid wall.
        if (ty >= LEVEL_ROWS) return '~';   // treat as lava for death plane
        return '.';
    }
    return grid[ty][tx];
}

static void set_tile(int tx, int ty, char c) {
    if (tx < 0 || tx >= level_w || ty < 0 || ty >= LEVEL_ROWS) return;
    grid[ty][tx] = c;
}

// ─────────────────────────────────────────────
//  ENTITIES (player, enemies, pickups, effects)
// ─────────────────────────────────────────────
enum EntityKind {
    EK_DEAD = 0,
    EK_COIN,
    EK_MUSHROOM,
    EK_STAR,
    EK_GOOMBA,
    EK_KOOPA,         // walking turtle
    EK_KOOPA_SHELL,   // stunned shell (kickable)
    EK_KOOPA_SLIDE,   // kicked shell sliding
    EK_BUMP_PARTICLE, // visual brick chunk
    EK_COIN_POP,      // brief "+200" floater
};

struct Entity {
    EntityKind kind;
    int32_t    x_q8;    // pixel x in 1/256ths (fixed-point)
    int32_t    y_q8;    // pixel y in 1/256ths
    int32_t    vx_q8;   // pixel velocity per tick in 1/256ths
    int32_t    vy_q8;
    uint8_t    w;       // bbox width in pixels
    uint8_t    h;       // bbox height in pixels
    uint8_t    facing;  // 0 = left, 1 = right
    uint8_t    timer;   // generic countdown frames
    int16_t    spawn_tx;
    int16_t    spawn_ty;
};

static constexpr int MAX_ENTITIES = 48;
static Entity entities[MAX_ENTITIES];
static int    entity_count = 0;

static Entity* alloc_entity() {
    for (int i = 0; i < MAX_ENTITIES; i++) {
        if (entities[i].kind == EK_DEAD) {
            entities[i] = Entity{};
            return &entities[i];
        }
    }
    if (entity_count < MAX_ENTITIES) {
        Entity* e = &entities[entity_count++];
        *e = Entity{};
        return e;
    }
    return nullptr;
}

static void spawn_entity(EntityKind k, int tx, int ty) {
    Entity* e = alloc_entity();
    if (!e) return;
    e->kind     = k;
    e->x_q8     = (int32_t)tx * TILE * 256;
    e->y_q8     = (int32_t)ty * TILE * 256;
    e->vx_q8   = 0;
    e->vy_q8   = 0;
    e->facing  = 0;
    e->spawn_tx = tx;
    e->spawn_ty = ty;
    switch (k) {
        case EK_COIN:        e->w = TILE - 4; e->h = TILE - 4; break;
        case EK_MUSHROOM:    e->w = TILE - 2; e->h = TILE - 2; e->vx_q8 = 60; break;
        case EK_STAR:        e->w = TILE - 2; e->h = TILE - 2; e->vx_q8 = 80; e->vy_q8 = -200; break;
        case EK_GOOMBA:      e->w = TILE - 2; e->h = TILE - 2; e->vx_q8 = -40; break;
        case EK_KOOPA:       e->w = TILE - 2; e->h = TILE - 2; e->vx_q8 = -36; break;
        case EK_KOOPA_SHELL: e->w = TILE - 2; e->h = TILE - 2; break;
        case EK_KOOPA_SLIDE: e->w = TILE - 2; e->h = TILE - 2; break;
        case EK_COIN_POP:    e->w = 0;        e->h = 0;        e->timer = 40; break;
        case EK_BUMP_PARTICLE: e->w = 4;      e->h = 4;        e->timer = 18; break;
        default: break;
    }
}

// ─────────────────────────────────────────────
//  PLAYER + GLOBAL STATE
// ─────────────────────────────────────────────
struct Player {
    int32_t  x_q8;
    int32_t  y_q8;
    int32_t  vx_q8;
    int32_t  vy_q8;
    uint8_t  w;
    uint8_t  h;
    uint8_t  on_ground;
    uint8_t  facing;       // 0 = left, 1 = right
    uint8_t  big;          // 0 = small (one-hit), 1 = big (mushroom)
    uint16_t star_timer;   // frames of invincibility remaining
    uint16_t hurt_timer;   // brief immunity after taking a hit
    int8_t   jump_hold;    // frames of variable jump remaining
};

static Player  player;
static int32_t cam_x_q8 = 0;       // camera left edge in pixel-q8
static int     coins = 0;
static int     score = 0;
static int     lives = 3;
static int     time_left = 400;    // seconds * 1
static uint32_t time_last_tick = 0;
static int     current_level = 0;
static bool    level_won = false;
static bool    player_dead = false;
static uint32_t death_anim_start = 0;

// Persistent: furthest level reached, restored from NoSQL.
static int     furthest_reached = 0;

// ─────────────────────────────────────────────
//  NOSQL PERSISTENCE
//
//  We keep one tiny entry in the "settings" NoSQL category:
//    title="mario_progress" content="<level_index>"
//  Loaded once on game start, written when a level is cleared.
// ─────────────────────────────────────────────
static void mario_load_progress() {
    furthest_reached = 0;
    nosql_init("settings");
    int total = nosql_get_count("settings");
    String t, c;
    for (int i = 0; i < total; i++) {
        if (!nosql_get_entry("settings", i, t, c)) continue;
        if (t == "mario_progress") {
            int v = c.toInt();
            if (v < 0) v = 0;
            if (v > NUM_LEVELS - 1) v = NUM_LEVELS - 1;
            furthest_reached = v;
            return;
        }
    }
}

static void mario_save_progress() {
    nosql_init("settings");
    char buf[8];
    snprintf(buf, sizeof(buf), "%d", furthest_reached);
    nosql_save_entry("settings", "mario_progress", buf);
}

// ─────────────────────────────────────────────
//  LEVEL LOAD
//
//  Copies the const level rows into the mutable grid, walks
//  every cell extracting entities, and finds the player spawn.
// ─────────────────────────────────────────────
static void load_level(int idx) {
    const LevelDef& ld = LEVELS[idx];
    int w = (int)strlen(ld.rows[0]);
    if (w > MAX_LEVEL_W) w = MAX_LEVEL_W;
    level_w = w;

    // Clear entities first
    for (int i = 0; i < MAX_ENTITIES; i++) entities[i].kind = EK_DEAD;
    entity_count = 0;

    int player_spawn_tx = 2;
    int player_spawn_ty = LEVEL_ROWS - 3;

    // Copy + extract
    for (int y = 0; y < LEVEL_ROWS; y++) {
        const char* src = ld.rows[y];
        int srcLen = (int)strlen(src);
        for (int x = 0; x < w; x++) {
            char c = (x < srcLen) ? src[x] : '.';
            switch (c) {
                case 'P':
                    player_spawn_tx = x;
                    player_spawn_ty = y;
                    grid[y][x] = '.';
                    break;
                case '*':
                    spawn_entity(EK_COIN, x, y);
                    grid[y][x] = '.';
                    break;
                case 'M':
                    spawn_entity(EK_MUSHROOM, x, y);
                    grid[y][x] = '.';
                    break;
                case 'S':
                    spawn_entity(EK_STAR, x, y);
                    grid[y][x] = '.';
                    break;
                case 'g':
                    spawn_entity(EK_GOOMBA, x, y);
                    grid[y][x] = '.';
                    break;
                case 'k':
                    spawn_entity(EK_KOOPA, x, y);
                    grid[y][x] = '.';
                    break;
                default:
                    grid[y][x] = c;
                    break;
            }
        }
        grid[y][w] = '\0';
    }

    // Initialize player
    player.x_q8 = (int32_t)player_spawn_tx * TILE * 256;
    player.y_q8 = (int32_t)player_spawn_ty * TILE * 256;
    player.vx_q8 = 0;
    player.vy_q8 = 0;
    player.w = TILE - 4;
    player.h = TILE - 2;
    player.on_ground = 0;
    player.facing = 1;
    // Preserve big/star state across levels-in-life? Classic SMB
    // gives you small at the start of each level if you died, big
    // if you cleared. Simpler: always start small, grow on power-up.
    player.big = 0;
    player.star_timer = 0;
    player.hurt_timer = 0;
    player.jump_hold = 0;

    cam_x_q8 = 0;
    time_left = 400;
    time_last_tick = millis();
    current_level = idx;
    level_won = false;
    player_dead = false;
}

// ─────────────────────────────────────────────
//  RENDER HELPERS
//
//  All rendering is in display coordinates (vx() + ..., vy() +
//  HUD_H + ...). Tile sprites are drawn as flat rectangles with
//  accent lines/dots to suggest pixel art without needing a
//  bitmap. Entities are drawn as small filled shapes.
// ─────────────────────────────────────────────
static int px_x(int32_t world_x_q8) {
    return vx() + (int)((world_x_q8 - cam_x_q8) >> 8);
}
static int px_y(int32_t world_y_q8) {
    return vy() + HUD_H + (int)(world_y_q8 >> 8);
}

static void draw_tile_cell(int tx, int ty) {
    char c = tile_at(tx, ty);
    const TileDef* t = lookup_tile(c);
    if (t->flags == TF_EMPTY) return;

    int px = vx() + tx * TILE - (int)(cam_x_q8 >> 8);
    int py = vy() + HUD_H + ty * TILE;
    if (px + TILE <= vx() || px >= vx() + VIEW_W) return;   // offscreen

    // Block fill
    if (c == '^') {
        // Spikes: triangle row sitting on top of the underlying tile cell
        gfx->fillRect(px, py + TILE / 2, TILE, TILE / 2, 0x4208);
        int tip_y = py + 2;
        int base_y = py + TILE / 2 + 1;
        for (int i = 0; i < TILE; i += 3) {
            gfx->fillTriangle(px + i, base_y,
                              px + i + 1, tip_y,
                              px + i + 3, base_y,
                              0xC618);
        }
        return;
    }
    if (c == '~') {
        gfx->fillRect(px, py, TILE, TILE, 0xF800);
        // Lava shimmer line
        int shimmer = (int)((millis() / 80) % TILE);
        gfx->drawFastHLine(px, py + (shimmer + 0) % TILE, TILE, 0xFD20);
        gfx->drawFastHLine(px, py + (shimmer + TILE/2) % TILE, TILE, 0xFFE0);
        return;
    }
    if (c == 'F') {
        // Flagpole: vertical line + a flag triangle. Top of pole at row top.
        gfx->fillRect(px + TILE/2 - 1, py - TILE * 6, 2, TILE * 7, 0xC618);
        gfx->fillTriangle(px + TILE/2, py - TILE * 6,
                          px + TILE - 1, py - TILE * 5,
                          px + TILE/2, py - TILE * 5 + 2,
                          t->color);
        // Pole base
        gfx->fillRect(px + 2, py + TILE - 3, TILE - 4, 3, 0x8410);
        return;
    }
    if (c == '?') {
        gfx->fillRect(px, py, TILE, TILE, t->color);
        gfx->drawRect(px, py, TILE, TILE, t->accent);
        // Question mark glyph (centered)
        int cx = px + TILE / 2;
        int cy = py + TILE / 2;
        gfx->setTextSize(1);
        gfx->setTextColor(0x0000);
        gfx->setCursor(cx - 3, cy - 4);
        gfx->print("?");
        return;
    }
    if (c == '_') {
        // Pipe top: green slab with darker accent
        gfx->fillRect(px - 1, py, TILE + 2, TILE, t->color);
        gfx->drawRect(px - 1, py, TILE + 2, TILE, t->accent);
        gfx->fillRect(px + 1, py + 2, TILE - 2, TILE - 4, 0x0420);
        return;
    }
    if (c == '|') {
        gfx->fillRect(px, py, TILE, TILE, t->color);
        gfx->drawFastVLine(px, py, TILE, t->accent);
        gfx->drawFastVLine(px + TILE - 1, py, TILE, t->accent);
        return;
    }
    if (c == 'b' || c == 'B') {
        gfx->fillRect(px, py, TILE, TILE, t->color);
        // Brick lines
        gfx->drawRect(px, py, TILE, TILE, t->accent);
        gfx->drawFastHLine(px, py + TILE / 2, TILE, t->accent);
        gfx->drawFastVLine(px + TILE / 2, py, TILE / 2, t->accent);
        gfx->drawFastVLine(px + TILE / 4, py + TILE / 2, TILE / 2, t->accent);
        return;
    }
    if (c == '=') {
        // Platform: thin top stripe + ribbed underside
        gfx->fillRect(px, py, TILE, TILE / 2, t->color);
        gfx->fillRect(px, py + TILE / 2, TILE, TILE / 2, t->accent);
        gfx->drawRect(px, py, TILE, TILE, 0x4208);
        return;
    }
    if (c == 'X' || c == 'C') {
        gfx->fillRect(px, py, TILE, TILE, t->color);
        gfx->drawRect(px, py, TILE, TILE, t->accent);
        // Speckle
        gfx->drawPixel(px + 3, py + 2, t->accent);
        gfx->drawPixel(px + TILE - 4, py + TILE - 4, t->accent);
        return;
    }
    // Default ground/dirt
    gfx->fillRect(px, py, TILE, TILE, t->color);
    gfx->drawRect(px, py, TILE, TILE, t->accent);
    // Grass cap on the very top row of the ground band
    if (ty > 0 && lookup_tile(tile_at(tx, ty - 1))->flags == TF_EMPTY) {
        gfx->drawFastHLine(px, py, TILE, 0x07E0);
        gfx->drawFastHLine(px, py + 1, TILE, 0x0420);
    }
}

static void draw_world() {
    int cam_px = (int)(cam_x_q8 >> 8);
    int first_col = cam_px / TILE;
    if (first_col < 0) first_col = 0;
    int last_col = first_col + VIS_COLS + 1;
    if (last_col > level_w) last_col = level_w;

    for (int tx = first_col; tx < last_col; tx++) {
        for (int ty = 0; ty < LEVEL_ROWS; ty++) {
            draw_tile_cell(tx, ty);
        }
    }
}

static void draw_entity(const Entity& e) {
    int px = px_x(e.x_q8);
    int py = px_y(e.y_q8);
    if (px + e.w < vx() || px > vx() + VIEW_W) return;

    switch (e.kind) {
        case EK_COIN: {
            int cx = px + e.w / 2;
            int cy = py + e.h / 2;
            int r  = e.w / 2 - 1;
            if (r < 2) r = 2;
            gfx->fillCircle(cx, cy, r, 0xFFE0);
            gfx->drawCircle(cx, cy, r, 0xFD20);
            gfx->drawFastVLine(cx, cy - r + 2, r * 2 - 4, 0xFD20);
            break;
        }
        case EK_MUSHROOM: {
            // Red cap, white spots, peach base
            gfx->fillRect(px, py + e.h / 2, e.w, e.h / 2, 0xFDB8);
            gfx->fillRect(px, py, e.w, e.h / 2, 0xF800);
            gfx->fillRect(px + 2, py + 2, 3, 3, 0xFFFF);
            gfx->fillRect(px + e.w - 5, py + 2, 3, 3, 0xFFFF);
            break;
        }
        case EK_STAR: {
            uint16_t col = ((millis() / 80) & 1) ? 0xFFE0 : 0xFFFF;
            int cx = px + e.w / 2;
            int cy = py + e.h / 2;
            int r = e.w / 2;
            gfx->fillTriangle(cx, cy - r, cx - r, cy + r, cx + r, cy + r, col);
            gfx->fillTriangle(cx, cy + r, cx - r, cy - r/2, cx + r, cy - r/2, col);
            break;
        }
        case EK_GOOMBA: {
            // Brown mushroom-shaped walker
            gfx->fillRect(px, py + e.h / 2, e.w, e.h / 2, 0x8208);
            gfx->fillRect(px, py, e.w, e.h / 2 + 1, 0x6105);
            // Eyes
            gfx->fillRect(px + 2, py + 3, 2, 2, 0xFFFF);
            gfx->fillRect(px + e.w - 4, py + 3, 2, 2, 0xFFFF);
            gfx->fillRect(px + 3, py + 4, 1, 1, 0x0000);
            gfx->fillRect(px + e.w - 3, py + 4, 1, 1, 0x0000);
            break;
        }
        case EK_KOOPA: {
            // Green turtle: shell + head
            gfx->fillRect(px, py + 2, e.w, e.h - 2, 0x07E0);
            gfx->drawRect(px, py + 2, e.w, e.h - 2, 0x0420);
            // Head poking out depending on facing
            int hx = e.facing ? (px + e.w - 3) : px;
            gfx->fillRect(hx, py, 3, 4, 0xFFE0);
            break;
        }
        case EK_KOOPA_SHELL:
        case EK_KOOPA_SLIDE: {
            gfx->fillRect(px, py + 2, e.w, e.h - 2, 0x07E0);
            gfx->drawRect(px, py + 2, e.w, e.h - 2, 0xFFE0);
            // Inner darker stripe
            gfx->drawFastHLine(px + 1, py + e.h / 2, e.w - 2, 0x0420);
            break;
        }
        case EK_COIN_POP: {
            gfx->setTextSize(1);
            gfx->setTextColor(0xFFE0);
            gfx->setCursor(px, py - (40 - e.timer) / 2);
            gfx->print("+200");
            break;
        }
        case EK_BUMP_PARTICLE: {
            gfx->fillRect(px, py, e.w, e.h, 0xC388);
            break;
        }
        default: break;
    }
}

static void draw_entities() {
    for (int i = 0; i < MAX_ENTITIES; i++) {
        if (entities[i].kind != EK_DEAD) draw_entity(entities[i]);
    }
}

static void draw_player() {
    int px = px_x(player.x_q8);
    int py = px_y(player.y_q8);

    // Star flicker: skip every other frame while invincible
    if (player.star_timer > 0 && ((player.star_timer / 4) & 1)) return;
    if (player.hurt_timer > 0 && (player.hurt_timer & 1)) return;

    int h = player.h;
    int w = player.w;
    uint16_t suit = 0x07FF;   // Captain Pisces — cyan space suit
    uint16_t helm = 0xFFFF;
    uint16_t visor = 0x001F;
    if (player.big) {
        h = player.h;   // (kept same; big mode is a hit-buffer, not a size change here)
    }

    // Body
    gfx->fillRect(px, py + h / 2, w, h / 2, suit);
    // Head
    gfx->fillRect(px + 1, py, w - 2, h / 2, helm);
    // Visor
    int vy0 = py + 2;
    if (player.facing) {
        gfx->fillRect(px + w / 2 - 1, vy0, w / 2, 3, visor);
    } else {
        gfx->fillRect(px + 1,       vy0, w / 2, 3, visor);
    }
    // Backpack tank highlight
    gfx->drawFastVLine(player.facing ? px : px + w - 1, py + h / 2, h / 2 - 1, 0xC618);
}

// ─────────────────────────────────────────────
//  HUD
// ─────────────────────────────────────────────
static void draw_hud() {
    int ox = vx();
    int oy = vy();
    gfx->fillRect(ox, oy, VIEW_W, HUD_H, 0x0000);
    gfx->drawFastHLine(ox, oy + HUD_H - 1, VIEW_W, 0x4208);
    gfx->setTextSize(1);
    gfx->setTextColor(0xFFFF);
    gfx->setCursor(ox + 4, oy + 2);
    gfx->printf("LV%-2d  COIN %03d  SC %05d", current_level + 1, coins, score);
    gfx->setCursor(ox + VIEW_W - 60, oy + 2);
    gfx->printf("L%d  T%03d", lives, time_left);
}

// ─────────────────────────────────────────────
//  COLLISION HELPERS
//
//  Convert a pixel AABB to the range of tile cells it overlaps,
//  then check each cell's tile flags.
// ─────────────────────────────────────────────
struct AABB { int32_t x, y, w, h; };   // pixel-q8 coords; w,h in pixels

static bool aabb_overlap(int32_t ax, int32_t ay, int aw, int ah,
                         int32_t bx, int32_t by, int bw, int bh) {
    return (ax >> 8) < ((bx >> 8) + bw) &&
           ((ax >> 8) + aw) > (bx >> 8) &&
           (ay >> 8) < ((by >> 8) + bh) &&
           ((ay >> 8) + ah) > (by >> 8);
}

static bool tile_is_solid(char c, bool from_above) {
    const TileDef* t = lookup_tile(c);
    if (t->flags & TF_SOLID) return true;
    if ((t->flags & TF_PLATFORM) && from_above) return true;
    return false;
}

// Resolve horizontal movement: try to move by dx (pixel-q8). If we'd
// collide with a solid tile, snap to its edge. Returns true if the
// move was blocked.
static bool move_horiz(int32_t& x_q8, int32_t y_q8, int w, int h, int32_t dx) {
    int32_t new_x = x_q8 + dx;
    int px = (int)(new_x >> 8);
    int py = (int)(y_q8 >> 8);
    int tx_lo, tx_hi;
    if (dx > 0) {
        tx_lo = tx_hi = (px + w - 1) / TILE;
    } else if (dx < 0) {
        tx_lo = tx_hi = px / TILE;
    } else {
        x_q8 = new_x;
        return false;
    }
    int ty_lo = py / TILE;
    int ty_hi = (py + h - 1) / TILE;
    for (int ty = ty_lo; ty <= ty_hi; ty++) {
        for (int tx = tx_lo; tx <= tx_hi; tx++) {
            char c = tile_at(tx, ty);
            if (tile_is_solid(c, /*from_above=*/false)) {
                if (dx > 0) new_x = (int32_t)(tx * TILE - w) * 256;
                else        new_x = (int32_t)((tx + 1) * TILE) * 256;
                x_q8 = new_x;
                return true;
            }
        }
    }
    x_q8 = new_x;
    return false;
}

// Resolve vertical movement. Returns +1 if landed on ground, -1 if
// bumped head into ceiling, 0 if free.
//
// Also reports the tile that was hit (out_hit_tx, out_hit_ty, out_hit_c)
// when the player hits head-up — used to pop ? blocks and bricks.
static int move_vert(int32_t x_q8, int32_t& y_q8, int w, int h, int32_t dy,
                     int* out_hit_tx = nullptr, int* out_hit_ty = nullptr,
                     char* out_hit_c = nullptr) {
    int32_t new_y = y_q8 + dy;
    int px = (int)(x_q8 >> 8);
    int py = (int)(new_y >> 8);
    int ty_lo, ty_hi;
    bool from_above = (dy > 0);
    if (dy > 0) {
        ty_lo = ty_hi = (py + h - 1) / TILE;
    } else if (dy < 0) {
        ty_lo = ty_hi = py / TILE;
    } else {
        y_q8 = new_y;
        return 0;
    }
    int tx_lo = px / TILE;
    int tx_hi = (px + w - 1) / TILE;
    for (int ty = ty_lo; ty <= ty_hi; ty++) {
        for (int tx = tx_lo; tx <= tx_hi; tx++) {
            char c = tile_at(tx, ty);
            if (tile_is_solid(c, from_above)) {
                if (dy > 0) {
                    new_y = (int32_t)(ty * TILE - h) * 256;
                    y_q8 = new_y;
                    return +1;
                } else {
                    new_y = (int32_t)((ty + 1) * TILE) * 256;
                    y_q8 = new_y;
                    if (out_hit_tx) *out_hit_tx = tx;
                    if (out_hit_ty) *out_hit_ty = ty;
                    if (out_hit_c)  *out_hit_c  = c;
                    return -1;
                }
            }
        }
    }
    y_q8 = new_y;
    return 0;
}

// Quick check: is the cell ty just below the player's bbox solid? Used
// to test "still standing on ground" so the player doesn't levitate
// when walking off an edge.
static bool standing_on_ground(int32_t x_q8, int32_t y_q8, int w, int h) {
    int px = (int)(x_q8 >> 8);
    int py = (int)(y_q8 >> 8);
    int ty = (py + h) / TILE;
    int tx_lo = px / TILE;
    int tx_hi = (px + w - 1) / TILE;
    // Only count as ground if the foot is within 1 pixel of the tile top.
    if (((py + h) % TILE) != 0) return false;
    for (int tx = tx_lo; tx <= tx_hi; tx++) {
        char c = tile_at(tx, ty);
        if (tile_is_solid(c, /*from_above=*/true)) return true;
    }
    return false;
}

// ─────────────────────────────────────────────
//  PHYSICS CONSTANTS  (all in q8 pixel units per tick)
//
//  Game runs at ~60Hz; one "tick" = one frame.
// ─────────────────────────────────────────────
static constexpr int32_t GRAVITY      = 70;
static constexpr int32_t MAX_FALL     = 700;
static constexpr int32_t WALK_ACCEL   = 25;
static constexpr int32_t RUN_ACCEL    = 40;
static constexpr int32_t WALK_MAX     = 320;
static constexpr int32_t RUN_MAX      = 520;
static constexpr int32_t FRICTION     = 22;
static constexpr int32_t JUMP_IMPULSE = -780;
static constexpr int32_t JUMP_HOLD    = -55;
static constexpr int      JUMP_HOLD_FRAMES = 14;

// ─────────────────────────────────────────────
//  POWER-UP EFFECTS / DEATH
// ─────────────────────────────────────────────
static void give_coin() {
    coins++;
    score += 200;
    pm_game_audio_fx_line();
}

static void grow_player() {
    if (!player.big) {
        player.big = 1;
        score += 1000;
    } else {
        score += 1000;   // already big: bonus
    }
    pm_game_audio_fx_drop();
}

static void give_star() {
    player.star_timer = 600;   // 10 seconds at 60Hz
    score += 1000;
    pm_game_audio_fx_drop();
}

static void hurt_player() {
    if (player.hurt_timer > 0) return;
    if (player.star_timer > 0) return;
    if (player.big) {
        player.big = 0;
        player.hurt_timer = 90;
        return;
    }
    player_dead = true;
    death_anim_start = millis();
    player.vy_q8 = -800;
    pm_game_audio_fx_drop();
}

// ─────────────────────────────────────────────
//  ENEMY UPDATE
// ─────────────────────────────────────────────
static void update_entity(Entity& e) {
    if (e.kind == EK_DEAD) return;

    // Common gravity for things that fall
    bool falls = (e.kind == EK_GOOMBA || e.kind == EK_KOOPA ||
                  e.kind == EK_KOOPA_SHELL || e.kind == EK_KOOPA_SLIDE ||
                  e.kind == EK_MUSHROOM || e.kind == EK_STAR);
    if (falls) {
        e.vy_q8 += GRAVITY;
        if (e.vy_q8 > MAX_FALL) e.vy_q8 = MAX_FALL;
    }

    // Movement with tile collision (only for moving solids)
    if (e.kind == EK_GOOMBA || e.kind == EK_KOOPA ||
        e.kind == EK_KOOPA_SLIDE || e.kind == EK_MUSHROOM ||
        e.kind == EK_STAR) {
        int32_t x = e.x_q8;
        int32_t y = e.y_q8;
        bool blocked = move_horiz(x, y, e.w, e.h, e.vx_q8);
        if (blocked) {
            e.vx_q8 = -e.vx_q8;
            e.facing = !e.facing;
        }
        int vr = move_vert(x, y, e.w, e.h, e.vy_q8);
        if (vr > 0) e.vy_q8 = 0;
        if (vr < 0) e.vy_q8 = 0;
        e.x_q8 = x;
        e.y_q8 = y;

        // Edge-detect for walkers (so they don't walk off cliffs).
        // Star is allowed to fall off.
        if ((e.kind == EK_GOOMBA || e.kind == EK_KOOPA) && vr > 0) {
            int foot_tx = e.facing
                ? (int)((e.x_q8 >> 8) + e.w) / TILE
                : (int)(e.x_q8 >> 8) / TILE - 1;
            int foot_ty = (int)((e.y_q8 >> 8) + e.h) / TILE;
            char c = tile_at(foot_tx, foot_ty);
            if (!tile_is_solid(c, /*from_above=*/true)) {
                e.vx_q8 = -e.vx_q8;
                e.facing = !e.facing;
            }
        }

        // Fell into the void (below level)
        int py = (int)(e.y_q8 >> 8);
        if (py > LEVEL_ROWS * TILE + 60) {
            e.kind = EK_DEAD;
            return;
        }
    }

    if (e.kind == EK_KOOPA_SHELL) {
        // Static shell on ground until kicked. Apply gravity so it
        // falls if a brick under it is destroyed.
        int32_t x = e.x_q8;
        int32_t y = e.y_q8;
        int vr = move_vert(x, y, e.w, e.h, e.vy_q8);
        if (vr != 0) e.vy_q8 = 0;
        e.y_q8 = y;
        // Auto-revive after a few seconds of idle? Classic SMB does.
        e.timer++;
        if (e.timer > 240) {
            e.kind = EK_KOOPA;
            e.vx_q8 = -36;
            e.timer = 0;
        }
    }

    if (e.kind == EK_BUMP_PARTICLE) {
        e.vy_q8 += GRAVITY / 2;
        e.x_q8  += e.vx_q8;
        e.y_q8  += e.vy_q8;
        if (e.timer-- == 0) e.kind = EK_DEAD;
    }
    if (e.kind == EK_COIN_POP) {
        if (e.timer-- == 0) e.kind = EK_DEAD;
    }
}

// ─────────────────────────────────────────────
//  PLAYER vs ENTITY INTERACTIONS
// ─────────────────────────────────────────────
static void resolve_player_entities() {
    int32_t px = player.x_q8;
    int32_t py = player.y_q8;
    int     pw = player.w;
    int     ph = player.h;

    for (int i = 0; i < MAX_ENTITIES; i++) {
        Entity& e = entities[i];
        if (e.kind == EK_DEAD) continue;
        if (!aabb_overlap(px, py, pw, ph, e.x_q8, e.y_q8, e.w, e.h)) continue;

        switch (e.kind) {
            case EK_COIN:
                give_coin();
                {
                    Entity* p = alloc_entity();
                    if (p) {
                        p->kind = EK_COIN_POP;
                        p->x_q8 = e.x_q8;
                        p->y_q8 = e.y_q8;
                        p->timer = 40;
                    }
                }
                e.kind = EK_DEAD;
                break;

            case EK_MUSHROOM:
                grow_player();
                e.kind = EK_DEAD;
                break;

            case EK_STAR:
                give_star();
                e.kind = EK_DEAD;
                break;

            case EK_GOOMBA: {
                // Stomp if descending and player's feet are at/above
                // the goomba's middle.
                int p_foot = (int)((player.y_q8 + player.h * 256) >> 8);
                int g_mid  = (int)((e.y_q8 >> 8) + e.h / 2);
                if (player.vy_q8 > 0 && p_foot <= g_mid + 2) {
                    e.kind = EK_DEAD;
                    score += 100;
                    player.vy_q8 = JUMP_IMPULSE / 2;
                    pm_game_audio_fx_line();
                } else if (player.star_timer > 0) {
                    e.kind = EK_DEAD;
                    score += 200;
                } else {
                    hurt_player();
                }
                break;
            }

            case EK_KOOPA: {
                int p_foot = (int)((player.y_q8 + player.h * 256) >> 8);
                int k_mid  = (int)((e.y_q8 >> 8) + e.h / 2);
                if (player.vy_q8 > 0 && p_foot <= k_mid + 2) {
                    e.kind   = EK_KOOPA_SHELL;
                    e.vx_q8  = 0;
                    e.timer  = 0;
                    score   += 100;
                    player.vy_q8 = JUMP_IMPULSE / 2;
                    pm_game_audio_fx_line();
                } else if (player.star_timer > 0) {
                    e.kind = EK_DEAD;
                    score += 200;
                } else {
                    hurt_player();
                }
                break;
            }

            case EK_KOOPA_SHELL: {
                // Kick: shell becomes a slider going away from player.
                int p_center = (int)((player.x_q8 >> 8) + player.w / 2);
                int e_center = (int)((e.x_q8 >> 8) + e.w / 2);
                if (p_center < e_center) {
                    e.vx_q8 = 480;
                    e.facing = 1;
                } else {
                    e.vx_q8 = -480;
                    e.facing = 0;
                }
                e.kind = EK_KOOPA_SLIDE;
                score += 50;
                break;
            }

            case EK_KOOPA_SLIDE: {
                // Sliding shell kills the player on touch — unless
                // they're descending onto it, then it stops.
                int p_foot = (int)((player.y_q8 + player.h * 256) >> 8);
                int k_mid  = (int)((e.y_q8 >> 8) + e.h / 2);
                if (player.vy_q8 > 0 && p_foot <= k_mid + 2) {
                    e.kind  = EK_KOOPA_SHELL;
                    e.vx_q8 = 0;
                    e.timer = 0;
                    player.vy_q8 = JUMP_IMPULSE / 2;
                } else if (player.star_timer > 0) {
                    e.kind = EK_DEAD;
                    score += 200;
                } else {
                    hurt_player();
                }
                break;
            }

            default: break;
        }
    }
}

// ─────────────────────────────────────────────
//  PLAYER UPDATE
// ─────────────────────────────────────────────
static void update_player(const PMNesInput& in) {
    if (player.hurt_timer > 0) player.hurt_timer--;
    if (player.star_timer > 0) player.star_timer--;

    if (player_dead) {
        // Death animation: player flies up briefly, then falls
        player.vy_q8 += GRAVITY;
        if (player.vy_q8 > MAX_FALL) player.vy_q8 = MAX_FALL;
        player.y_q8 += player.vy_q8;
        return;
    }

    // Horizontal input + accel
    int32_t accel = (in.b ? RUN_ACCEL : WALK_ACCEL);
    int32_t maxv  = (in.b ? RUN_MAX   : WALK_MAX);
    if (in.left) {
        player.vx_q8 -= accel;
        if (player.vx_q8 < -maxv) player.vx_q8 = -maxv;
        player.facing = 0;
    } else if (in.right) {
        player.vx_q8 += accel;
        if (player.vx_q8 > maxv) player.vx_q8 = maxv;
        player.facing = 1;
    } else {
        // Friction
        if (player.vx_q8 > FRICTION)  player.vx_q8 -= FRICTION;
        else if (player.vx_q8 < -FRICTION) player.vx_q8 += FRICTION;
        else player.vx_q8 = 0;
    }

    // Jump
    if (in.a && player.on_ground) {
        player.vy_q8 = JUMP_IMPULSE;
        player.on_ground = 0;
        player.jump_hold = JUMP_HOLD_FRAMES;
        pm_game_audio_fx_drop();
    } else if (in.a && player.jump_hold > 0) {
        player.vy_q8 += JUMP_HOLD;
        player.jump_hold--;
    } else {
        player.jump_hold = 0;
    }

    // Gravity
    player.vy_q8 += GRAVITY;
    if (player.vy_q8 > MAX_FALL) player.vy_q8 = MAX_FALL;

    // Horizontal collision
    move_horiz(player.x_q8, player.y_q8, player.w, player.h, player.vx_q8);
    // Don't run off the left edge of the level
    if (player.x_q8 < cam_x_q8) player.x_q8 = cam_x_q8;

    // Vertical collision
    int hit_tx, hit_ty;
    char hit_c;
    int vr = move_vert(player.x_q8, player.y_q8, player.w, player.h,
                       player.vy_q8, &hit_tx, &hit_ty, &hit_c);
    if (vr > 0) {
        player.vy_q8 = 0;
        player.on_ground = 1;
    } else if (vr < 0) {
        player.vy_q8 = 0;
        player.jump_hold = 0;
        // Bump tile from below
        if (hit_c == '?' || hit_c == 'b') {
            const TileDef* t = lookup_tile(hit_c);
            if (t->flags & TF_BUMP) {
                if (hit_c == '?') {
                    set_tile(hit_tx, hit_ty, 'B');   // becomes hard solid
                    // Spawn a coin one tile above
                    spawn_entity(EK_COIN_POP, hit_tx, hit_ty - 1);
                    coins++;
                    score += 200;
                } else if (hit_c == 'b') {
                    // If big, destroy. Else just rattle (spawn particle).
                    if (player.big) {
                        set_tile(hit_tx, hit_ty, '.');
                        // Spawn 4 brick particle entities
                        for (int p = 0; p < 4; p++) {
                            Entity* pe = alloc_entity();
                            if (!pe) break;
                            pe->kind = EK_BUMP_PARTICLE;
                            pe->x_q8 = (int32_t)(hit_tx * TILE + (p & 1 ? TILE - 4 : 2)) * 256;
                            pe->y_q8 = (int32_t)(hit_ty * TILE + (p < 2 ? 2 : TILE - 4)) * 256;
                            pe->vx_q8 = (p & 1) ? 200 : -200;
                            pe->vy_q8 = -400;
                            pe->w = 4; pe->h = 4;
                            pe->timer = 24;
                        }
                        score += 50;
                    }
                }
                pm_game_audio_fx_line();
            }
        }
    } else {
        player.on_ground = 0;
    }

    // Stick-on-ground sense: if we walked off an edge without
    // setting on_ground=0 via vert resolution, fix it.
    if (player.on_ground && !standing_on_ground(player.x_q8, player.y_q8,
                                                player.w, player.h)) {
        player.on_ground = 0;
    }

    // Hazard check: any KILL tile under the player's feet/body
    int pxx = (int)(player.x_q8 >> 8);
    int pyy = (int)(player.y_q8 >> 8);
    int tx_lo = pxx / TILE;
    int tx_hi = (pxx + player.w - 1) / TILE;
    int ty_lo = pyy / TILE;
    int ty_hi = (pyy + player.h - 1) / TILE;
    for (int ty = ty_lo; ty <= ty_hi; ty++) {
        for (int tx = tx_lo; tx <= tx_hi; tx++) {
            char c = tile_at(tx, ty);
            const TileDef* t = lookup_tile(c);
            if (t->flags & TF_KILL) {
                if (player.star_timer == 0 && player.hurt_timer == 0) {
                    hurt_player();
                }
            }
            if (t->flags & TF_GOAL) {
                level_won = true;
                score += 5000 + time_left * 50;
                return;
            }
        }
    }

    // Death plane (fell off bottom)
    if (pyy > LEVEL_ROWS * TILE + 40) {
        if (!player_dead) {
            player_dead = true;
            death_anim_start = millis();
            player.vy_q8 = -800;
        }
    }

    // Resolve player vs entities
    resolve_player_entities();

    // Camera: never moves backwards. Scroll right when player crosses
    // 40% of the viewport.
    int32_t target_cam = player.x_q8 - (int32_t)(VIEW_W * 256 * 4 / 10);
    if (target_cam > cam_x_q8) cam_x_q8 = target_cam;
    int32_t max_cam = (int32_t)((level_w * TILE - VIEW_W)) * 256;
    if (cam_x_q8 > max_cam) cam_x_q8 = max_cam;
    if (cam_x_q8 < 0) cam_x_q8 = 0;
}

// ─────────────────────────────────────────────
//  TITLE / DEATH / WIN SCREENS
// ─────────────────────────────────────────────
static void draw_centered_text(const char* s, int y, uint16_t color, int size) {
    int char_w = 6 * size;
    int w = (int)strlen(s) * char_w;
    gfx->setTextSize(size);
    gfx->setTextColor(color);
    gfx->setCursor(vx() + (VIEW_W - w) / 2, vy() + y);
    gfx->print(s);
}

static void clear_play_area() {
    int ox = vx();
    int oy = vy();
    // Sky band
    gfx->fillRect(ox, oy + HUD_H, VIEW_W, PLAY_H, 0x549F);
    // Distant clouds (simple shapes)
    for (int i = 0; i < 4; i++) {
        int cx = ((int)((cam_x_q8 >> 8) / 6) + i * (VIEW_W / 3)) % (VIEW_W + 60) - 30;
        int cy = oy + HUD_H + 12 + (i & 1) * 6;
        gfx->fillCircle(ox + cx,      cy,     6, 0xFFFF);
        gfx->fillCircle(ox + cx + 7,  cy + 1, 7, 0xFFFF);
        gfx->fillCircle(ox + cx + 14, cy,     6, 0xFFFF);
    }
}

static void title_screen() {
    gfx->fillRect(vx(), vy(), VIEW_W, VIEW_H, 0x0000);
    draw_centered_text("CAPTAIN PISCES", 30, 0xFFE0, 2);
    draw_centered_text("BROTHERS", 60, 0x07FF, 2);
    char buf[40];
    snprintf(buf, sizeof(buf), "LEVEL %d / %d", current_level + 1, NUM_LEVELS);
    draw_centered_text(buf, 100, 0xFFFF, 1);
    snprintf(buf, sizeof(buf), "FURTHEST: %d", furthest_reached + 1);
    draw_centered_text(buf, 116, 0x8410, 1);
#ifdef DEVICE_CARDPUTER_ADV
    draw_centered_text("K JUMP   O RUN", VIEW_H - 30, 0xFFFF, 1);
    draw_centered_text("A/D MOVE   B START", VIEW_H - 18, 0xC618, 1);
#elif defined(DEVICE_TLORAPAGER)
    draw_centered_text("A JUMP   B RUN", VIEW_H - 30, 0xFFFF, 1);
    draw_centered_text("PAD MOVE   ENT START", VIEW_H - 18, 0xC618, 1);
#elif defined(DEVICE_C28P) || defined(DEVICE_MAXINE)
    draw_centered_text("A JUMP   B RUN", VIEW_H - 30, 0xFFFF, 1);
    draw_centered_text("TAP B TO START", VIEW_H - 18, 0xC618, 1);
#else
    draw_centered_text("A JUMP   B RUN", VIEW_H - 30, 0xFFFF, 1);
    draw_centered_text("PRESS START", VIEW_H - 18, 0xC618, 1);
#endif
    while (true) {
        PMNesInput in = pm_read_nes_input(true);
        if (in.quit) {
            current_level = -1;
            return;
        }
        if (in.start || in.a || in.b) {
            // Wait for release so we don't double-fire
            while (true) {
                PMNesInput in2 = pm_read_nes_input(true);
                if (!in2.start && !in2.a && !in2.b) break;
                delay(20);
                yield();
            }
            return;
        }
        delay(30);
        yield();
    }
}

static bool death_screen() {
    gfx->fillRect(vx(), vy() + HUD_H + PLAY_H / 2 - 30, VIEW_W, 60, 0x0000);
    draw_centered_text("OUCH!", HUD_H + PLAY_H / 2 - 18, 0xF800, 2);
    char buf[32];
    snprintf(buf, sizeof(buf), "LIVES LEFT: %d", lives);
    draw_centered_text(buf, HUD_H + PLAY_H / 2 + 6, 0xFFFF, 1);
    delay(1400);
    return lives > 0;
}

static void level_complete_screen() {
    gfx->fillRect(vx(), vy() + HUD_H + PLAY_H / 2 - 30, VIEW_W, 60, 0x0000);
    draw_centered_text("LEVEL CLEAR!", HUD_H + PLAY_H / 2 - 18, 0x07E0, 2);
    char buf[40];
    snprintf(buf, sizeof(buf), "TIME BONUS: %d", time_left * 50);
    draw_centered_text(buf, HUD_H + PLAY_H / 2 + 6, 0xFFFF, 1);
    snprintf(buf, sizeof(buf), "SCORE: %d", score);
    draw_centered_text(buf, HUD_H + PLAY_H / 2 + 18, 0xFFE0, 1);
    delay(2000);
}

static void game_complete_screen() {
    gfx->fillRect(vx(), vy(), VIEW_W, VIEW_H, 0x0000);
    draw_centered_text("YOU WIN!", 40, 0xFFE0, 3);
    draw_centered_text("ALL 30 LEVELS CLEARED", 90, 0x07E0, 1);
    char buf[40];
    snprintf(buf, sizeof(buf), "FINAL SCORE: %d", score);
    draw_centered_text(buf, 110, 0xFFFF, 2);
    draw_centered_text("Press any button", VIEW_H - 30, 0x8410, 1);
    while (true) {
        PMNesInput in = pm_read_nes_input(true);
        if (in.quit || in.a || in.b || in.start) return;
        delay(30);
        yield();
    }
}

// ─────────────────────────────────────────────
//  MAIN GAME LOOP
// ─────────────────────────────────────────────
void run_mario_bros() {
    pm_game_audio_begin();
#ifdef DEVICE_C28P
    c28p_dpad_render();
#endif
#ifdef DEVICE_MAXINE
    maxine_dpad_render();
#endif

    mario_load_progress();
    current_level = furthest_reached;
    coins = 0;
    score = 0;
    lives = 3;

    title_screen();
    if (current_level < 0) return;   // user quit from title

    load_level(current_level);

    uint32_t last_frame = millis();

    while (true) {
        PMNesInput in = pm_read_nes_input(true);
        if (in.quit) {
            mario_save_progress();
            return;
        }

        update_player(in);
        for (int i = 0; i < MAX_ENTITIES; i++) update_entity(entities[i]);

        // Tick the in-game timer down once per second.
        if (millis() - time_last_tick >= 1000) {
            time_last_tick += 1000;
            if (time_left > 0) time_left--;
            if (time_left == 0 && !player_dead && !level_won) {
                hurt_player();
            }
        }

        // Draw
        clear_play_area();
        draw_world();
        draw_entities();
        draw_player();
        draw_hud();

        // State transitions
        if (level_won) {
            level_complete_screen();
            if (current_level >= furthest_reached) {
                furthest_reached = current_level + 1;
                if (furthest_reached > NUM_LEVELS - 1)
                    furthest_reached = NUM_LEVELS - 1;
                mario_save_progress();
            }
            current_level++;
            if (current_level >= NUM_LEVELS) {
                game_complete_screen();
                return;
            }
            load_level(current_level);
            last_frame = millis();
            continue;
        }

        if (player_dead && millis() - death_anim_start > 1200) {
            lives--;
            if (!death_screen()) {
                game_complete_screen();   // shows final score
                return;
            }
            load_level(current_level);
            last_frame = millis();
            continue;
        }

        // Frame pacing — aim for ~60Hz
        uint32_t now = millis();
        uint32_t elapsed = now - last_frame;
        if (elapsed < 16) delay(16 - elapsed);
        last_frame = millis();
        yield();
    }
}

#endif // #if 0 — entire side-scroller body is deprecated; see banner at
       // top of this file. Remove this guard only if you intend to
       // revive the side-scroller AND have renamed its entry-point
       // symbol so it doesn't collide with the active arcade build.
